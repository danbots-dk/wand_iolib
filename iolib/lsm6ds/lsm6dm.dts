/dts-v1/;
/plugin/;

/ {
    compatible = "brcm,bcm2835";



    fragment@1 {
        target = <&i2c1>;
        __overlay__ {
            #address-cells = <1>;
            #size-cells = <0>;

            imu@6a {
                compatible = "st,lsm6dsm";
                reg = <0x6a>;
                //interrupt-parent = <&gpio>;
                //interrupts = <0 2>;
            };
        };
    };
};
