/dts-v1/;
/plugin/;
/ {
    compatible = "brcm,bcm2835", "brcm,bcm2836", "brcm,bcm2708", "brcm,bcm2709", "brcm,bcm2711";
    fragment@0 {
        target = <&i2c1>;
        __overlay__ {
            status = "okay";
            eeprom: at24@50 {
                compatible = "atmel,24c512","microchip,24c256","at24";
                #address-cells = <1>;
                #size-cells = <0>;
                reg = <0x50>;
                pagesize = <128>;
                size = <65536>;
                address-width = <16>;
            };
        };
    };
};
