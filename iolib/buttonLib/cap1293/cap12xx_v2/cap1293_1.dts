// Overlay for cap1293 from  Microchip Semiconductor
// add CONFIG_KEYBOARD_CAP11XX=y

/dts-v1/;
/plugin/;

/ {
        compatible = "brcm,bcm2835";
        fragment@0 {
                target = <0x101>; //phandle for i2c channel 1 on pca954x
                __overlay__{
                        status = "okay";
                        cap1293: cap1293@28 {
                                compatible = "microchip,cap1293";
                                pinctrl-0 = <&cap1293_pins>;
                                pinctrl-names = "default";
                                interrupt-parent = <&gpio>;
                                interrupts = <4 2>;
                                reg = <0x28>;
                                autorepeat;
                                microchip,sensor-gain = <2>;

                                linux,keycodes = <2>,
                                                <3>,            /* KEY_2 */
                                                <4>;            /* KEY_3 */           /* KEY_1 */



                                #address-cells = <1>;
                                #size-cells = <0>;
                                status = "okay";

                        };
                };
        };
        fragment@1 {
                target = <&gpio>;
                __overlay__ {
                        cap1293_pins: cap1293_pins {
                                brcm,pins = <4>;
                                brcm,function = <0>; /* in */
                                brcm,pull = <0>; /* none */
                        };
                };
        };

        __overrides__ {
                int_pin = <&cap1293>, "interrupts:0",
                          <&cap1293_pins>, "brcm,pins:0";
        };
};