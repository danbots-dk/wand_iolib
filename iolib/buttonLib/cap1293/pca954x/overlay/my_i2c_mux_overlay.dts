// Umbrella I2C Mux overlay

/dts-v1/;
/plugin/;


/{
	compatible = "brcm,bcm2835";

	fragment@0 {
		target = <&i2c1>;
		__dormant__ {
			#address-cells = <1>;
			#size-cells = <0>;
			status = "okay";

			pca9540: mux@70 {
				compatible = "nxp,pca9540";
				reg = <0x70>;
				#address-cells = <1>;
				#size-cells = <0>;

				i2c@0 {
					#address-cells = <1>;
					#size-cells = <0>;
					reg = <0>;
				};
				i2c@1 {
					#address-cells = <1>;
					#size-cells = <0>;
					reg = <1>;
				};
			};
		};
	};


	frag100: fragment@100 {
		target = <&i2c_arm>;
		i2cbus: __overlay__ {
			status = "okay";
		};
	};

	fragment@101 {
		target = <&i2c0if>;
		__dormant__ {
			status = "okay";
		};
	};

	fragment@102 {
		target = <&i2c0mux>;
		__dormant__ {
			status = "okay";
		};
	};

	__overrides__ {
		pca9540 = <0>, "+0";

		addr =  <&pca9540>,"reg:0";

		base =  <&pca9540>,"base-nr:0";
	};

};